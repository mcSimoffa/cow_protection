## firmware_client/main/Kconfig.projbuild
```kconfig
menu "Example Configuration"
	config WIFI_TIMEOUT_CONN
        int "WiFi timeout connection in milliseconds"
        default 10000
        help
            if this time expiered a notification to smartphone will be send
			
    config EXAMPLE_IPV4_ADDR
        string "IPV4 Address"
        default "192.168.0.165"
        help
            The example will connect to this IPV4 address.

    config EXAMPLE_PORT
        int "Port"
        range 0 65535
        default 9090
        help
            The remote port to which the client example will connect to.

    choice EXAMPLE_SOCKET_IP_INPUT
        prompt "Socket example source"
        default EXAMPLE_SOCKET_IP_INPUT_STRING
        help
            Selects the input source of the IP used in the example.

        config EXAMPLE_SOCKET_IP_INPUT_STRING
            bool "From string"

        config EXAMPLE_SOCKET_IP_INPUT_STDIN
            bool "From stdin"
    endchoice

endmenu
```
